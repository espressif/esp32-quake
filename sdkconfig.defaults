## sdkconfig.defaults
```kconfig
CONFIG_ESPTOOLPY_FLASHMODE_QIO=y
CONFIG_ESPTOOLPY_FLASHSIZE_16MB=y
CONFIG_PARTITION_TABLE_CUSTOM=y
CONFIG_COMPILER_OPTIMIZATION_PERF=y
# CONFIG_ETH_USE_SPI_ETHERNET is not set
CONFIG_SPIRAM=y
CONFIG_SPIRAM_SPEED_200M=y
CONFIG_SPIRAM_XIP_FROM_PSRAM=y
# CONFIG_SPIRAM_MEMTEST is not set
CONFIG_SPIRAM_ALLOW_BSS_SEG_EXTERNAL_MEMORY=y
CONFIG_SPIRAM_ALLOW_NOINIT_SEG_EXTERNAL_MEMORY=y
CONFIG_CACHE_L2_CACHE_256KB=y
CONFIG_CACHE_L2_CACHE_LINE_128B=y
CONFIG_ESP_SYSTEM_PANIC_GDBSTUB=y
CONFIG_ESP_CONSOLE_SECONDARY_NONE=y
# CONFIG_ESP_TASK_WDT_EN is not set
CONFIG_ESP_PANIC_HANDLER_IRAM=y
CONFIG_FATFS_LFN_STACK=y
CONFIG_USB_HOST_HUBS_SUPPORTED=y
CONFIG_USB_HOST_EXT_PORT_SUPPORT_LS=y
# CONFIG_BSP_ERROR_CHECK is not set
CONFIG_BSP_LCD_DPI_BUFFER_NUMS=2
CONFIG_IDF_EXPERIMENTAL_FEATURES=y
```
